## components/actuators/Kconfig
```kconfig
# Actuators Component Configuration

menu "Actuators Configuration"

    config ENABLE_ACTUATOR_EXHAUST_FAN
        bool "Enable Exhaust Fan"
        default y

    config ENABLE_ACTUATOR_COOLING_PAD
        bool "Enable Cooling Pad"
        default y

    config ENABLE_ACTUATOR_HEATER
        bool "Enable Heater"
        default y

    config ENABLE_ACTUATOR_LED_LIGHT
        bool "Enable LED Light"
        default y

    config ENABLE_ACTUATOR_FEEDER
        bool "Enable Feeder"
        default y

    config ENABLE_ACTUATOR_WATER_PUMP
        bool "Enable Water Pump"
        default y

    config ENABLE_ACTUATOR_ALARM
        bool "Enable Alarm"
        default y

endmenu
```

## components/communication/Kconfig
```kconfig
# Communication Component Configuration

menu "Communication Configuration"

    config ENABLE_COMM_WIFI
        bool "Enable WiFi"
        default y

    config ENABLE_COMM_MQTT
        bool "Enable MQTT"
        default y

    config ENABLE_COMM_OTA
        bool "Enable OTA Updates"
        default n

endmenu
```

## components/control/Kconfig
```kconfig
# Control Component Configuration

menu "Control Configuration"

    config ENABLE_CONTROL_RULES_ENGINE
        bool "Enable Rules Engine"
        default y

    config ENABLE_CONTROL_PID
        bool "Enable PID Controller"
        default y

    config ENABLE_CONTROL_ENERGY_OPTIMIZER
        bool "Enable Energy Optimizer"
        default y

    config ENABLE_CONTROL_EMERGENCY_PROTOCOL
        bool "Enable Emergency Protocol"
        default y

endmenu
```

## components/sensors/Kconfig
```kconfig
# Sensors Component Configuration

menu "Sensors Configuration"

    config ENABLE_SENSOR_DHT22
        bool "Enable DHT22 Temperature/Humidity Sensor"
        default y

    config ENABLE_SENSOR_DS18B20
        bool "Enable DS18B20 Temperature Sensor"
        default y

    config ENABLE_SENSOR_MQ135
        bool "Enable MQ135 Air Quality Sensor"
        default y

    config ENABLE_SENSOR_MQ7
        bool "Enable MQ7 CO Sensor"
        default y

    config ENABLE_SENSOR_MQ2
        bool "Enable MQ2 Smoke/Gas Sensor"
        default y

    config ENABLE_SENSOR_LDR
        bool "Enable LDR Light Sensor"
        default y

    config ENABLE_SENSOR_WATER_LEVEL
        bool "Enable Water Level Sensor"
        default y

    config ENABLE_SENSOR_SOUND
        bool "Enable Sound Sensor"
        default y

    config ENABLE_SENSOR_BMP280
        bool "Enable BMP280 Pressure/Temperature Sensor"
        default y

    config ENABLE_SENSOR_SGP30
        bool "Enable SGP30 Air Quality Sensor"
        default y

    config ENABLE_SENSOR_PMS5003
        bool "Enable PMS5003 Air Quality Sensor"
        default y

    config ENABLE_SENSOR_HX711
        bool "Enable HX711 Load Cell"
        default y

    config ENABLE_SENSOR_ACS712
        bool "Enable ACS712 Current Sensor"
        default y

endmenu
```

## components/storage/Kconfig
```kconfig
# Storage Component Configuration

menu "Storage Configuration"

    config ENABLE_STORAGE_NVS
        bool "Enable NVS Storage"
        default y

    config ENABLE_STORAGE_SPIFFS
        bool "Enable SPIFFS File System"
        default y

endmenu
```
